## package/C201_D/src/Kconfig
```kconfig
config USB_ARTOSYN_USB_8020
	tristate "artosyn usb 8020"
	depends on USB
	help
	  artosyn usb 8020 module
```

## package/simcom/src/Kconfig
```kconfig
config USB_NET_SIMCOM_SIM7600
	tristate "simcom 7600ce"
	depends on USB_USBNET
	help
	  SIMCOM 7600CE 4G LTE module
```
